#include "driver/gpio.h"
#include "esp_err.h"
#include "esp_log.h"
#include "freertos/freertos.h"
#include "freertos/task.h"
#include "sdkconfig.h" // generated by "make menuconfig"
#include "common.h"
#include "mqtt.h"
#include "esp_sleep.h"
#include "sensors.h"
#include "bme280_defs.h"

#define TAG "Main"

void app_main(void)
{
	mqtt_client_init();
	for (int i = 0; i < 10; i++)
	{
		int rslt = sensors_init();
		if (rslt != BME280_OK)
		{
			ESP_LOGE(TAG, "init or setting error. code: %d", rslt);
			vTaskDelay(pdMS_TO_TICKS(100));
			continue;
		}
		rslt = sensors_acquire();
		if (rslt != BME280_OK)
		{
			ESP_LOGE(TAG, "error reading sensors. code: %d", rslt);
			vTaskDelay(pdMS_TO_TICKS(100));
			continue;
		}

		mqtt_publish_value("home/garage/temperature", sensors_temp());
		mqtt_publish_value("home/garage/humidity", sensors_humidity());
		mqtt_publish_value("home/garage/pressure", sensors_pressure());
		vTaskDelay(pdMS_TO_TICKS(1000));
		break;
	}
	mqtt_client_deinit();

	const int wakeup_time_sec = 5 * 60;
	printf("Enabling timer wakeup, %ds\n", wakeup_time_sec);
	ESP_ERROR_CHECK(esp_sleep_enable_timer_wakeup(wakeup_time_sec * 1000000));
	esp_deep_sleep_start();
	vTaskDelete(NULL);
}
